## CMakeLists.txt
```
cmake_minimum_required(VERSION 3.20.0)
find_package(Zephyr REQUIRED HINTS $ENV{ZEPHYR_BASE})
project(embedded_hil_automation)

# Keep protocol/transport in main.c; LED-specific Zephyr GPIO in led_control.c.
target_sources(app PRIVATE src/main.c src/led_control.c)

# Identity is explicit so Python can reject a mismatched connected board.
# nRF54L15 support is NOT validated yet; add its board-specific settings later.
if(BOARD MATCHES "nrf52840dk")
  target_compile_definitions(app PRIVATE HIL_BOARD_ID=\"nrf52840dk\")
elseif(BOARD MATCHES "nrf54l15dk")
  target_compile_definitions(app PRIVATE HIL_BOARD_ID=\"nrf54l15dk\")
else()
  target_compile_definitions(app PRIVATE HIL_BOARD_ID=\"unknown_zephyr_board\")
endif()
```

## prj.conf
```kconfig
# Tested on nRF52840 DK with Nordic nRF Connect SDK 3.2.0.
CONFIG_GPIO=y
CONFIG_SERIAL=y
CONFIG_CONSOLE=y
CONFIG_UART_CONSOLE=y
CONFIG_PRINTK=y
# No Zephyr banner/logging on protocol UART: Python expects JSON only.
CONFIG_BOOT_BANNER=n
CONFIG_LOG=n
```

## src/main.c
```c
/*
 * Minimal nRF/Zephyr JSON-lines firmware for Python + Robot Framework HIL.
 * Verified architecture on nRF52840 DK: J-Link CDC UART at 115200 baud.
 *
 * WHY BUSY POLLING? An earlier receive loop used k_msleep(1) while waiting
 * for bytes. At 115200 baud that lost characters and corrupted JSON commands.
 * This phase intentionally uses uart_poll_in() without sleeping. It consumes
 * CPU; migrate to interrupt-driven UART/ring buffer for production firmware.
 *
 * JSON support is intentionally narrow: fixed ASCII keys and scalar values
 * produced by Python json.dumps(). It is NOT a general-purpose JSON parser.
 * Future protocol growth should use a proper parser and input validation.
 */
#include <stdbool.h>
#include <stdio.h>
#include <stdlib.h>
#include <string.h>
#include <zephyr/device.h>
#include <zephyr/devicetree.h>
#include <zephyr/drivers/uart.h>

#include "led_control.h"

#ifndef HIL_BOARD_ID
#define HIL_BOARD_ID "unknown_zephyr_board"
#endif

#define RX_LINE_MAX 256
static const struct device *const uart = DEVICE_DT_GET(DT_CHOSEN(zephyr_console));

static void send_line(const char *text)
{
    while (*text != '\0') {
        uart_poll_out(uart, (unsigned char)*text++);
    }
    uart_poll_out(uart, '\n');
}

/* Locate an exact JSON key followed by a colon. Values may contain spaces. */
static const char *value_for_key(const char *json, const char *key)
{
    char needle[40];
    if (snprintf(needle, sizeof(needle), "\"%s\"", key) >= sizeof(needle)) {
        return NULL;
    }
    const char *p = strstr(json, needle);
    if (p == NULL) {
        return NULL;
    }
    p += strlen(needle);
    while (*p == ' ' || *p == '\t') { ++p; }
    if (*p++ != ':') { return NULL; }
    while (*p == ' ' || *p == '\t') { ++p; }
    return p;
}

static bool string_equals(const char *value, const char *expected)
{
    if (value == NULL || *value != '"') { return false; }
    size_t n = strlen(expected);
    return strncmp(value + 1, expected, n) == 0 && value[n + 1] == '"';
}

static bool parse_index(const char *json, int *index)
{
    const char *p = value_for_key(json, "index");
    if (p == NULL || *p < '0' || *p > '9') { return false; }
    char *end;
    long n = strtol(p, &end, 10);
    if (end == p || n < 1 || n > 100) { return false; }
    *index = (int)n;
    return true;
}

static void handle_request(const char *line)
{
    const char *cmd = value_for_key(line, "cmd");
    char reply[128];
    if (string_equals(cmd, "STATUS")) {
        send_line("{\"status\":\"READY\"}");
    } else if (string_equals(cmd, "IDENTITY")) {
        snprintf(reply, sizeof(reply),
                 "{\"board\":\"%s\",\"firmware\":\"hil-serial-v2\",\"backend\":\"serial\"}",
                 HIL_BOARD_ID);
        send_line(reply);
    } else if (string_equals(cmd, "CAPABILITIES")) {
        snprintf(reply, sizeof(reply),
                 "{\"led_count\":%d,\"features\":[\"gpio\"]}",
                 led_control_count());
        send_line(reply);
    } else if (string_equals(cmd, "LED_SET")) {
        int index;
        const char *on = value_for_key(line, "on");
        if (!parse_index(line, &index) || on == NULL ||
            (strncmp(on, "true", 4) != 0 && strncmp(on, "false", 5) != 0)) {
            send_line("{\"error\":\"invalid LED_SET arguments\"}");
            return;
        }
        bool state = strncmp(on, "true", 4) == 0;
        if (led_control_set(index, state) != 0) {
            send_line("{\"error\":\"LED_SET failed or index out of range\"}");
        } else {
            send_line("{\"ok\":true}");
        }
    } else if (string_equals(cmd, "LED_GET")) {
        int index;
        bool on;
        if (!parse_index(line, &index) || led_control_get(index, &on) != 0) {
            send_line("{\"error\":\"LED_GET failed or index out of range\"}");
        } else {
            send_line(on ? "{\"on\":true}" : "{\"on\":false}");
        }
    } else {
        send_line("{\"error\":\"unsupported command\"}");
    }
}

int main(void)
{
    if (!device_is_ready(uart)) { return 1; }
    if (led_control_init() != 0) { return 1; }

    char line[RX_LINE_MAX];
    size_t used = 0;
    unsigned char ch;
    for (;;) {
        if (uart_poll_in(uart, &ch) != 0) {
            continue; /* DO NOT add k_msleep(1): serial bytes were lost. */
        }
        if (ch == '\r') { continue; }
        if (ch == '\n') {
            if (used > 0) {
                line[used] = '\0';
                handle_request(line);
                used = 0;
            }
        } else if (used < sizeof(line) - 1) {
            line[used++] = (char)ch;
        } else {
            /* Drop oversized line; report failure and resync at next newline. */
            used = 0;
            send_line("{\"error\":\"request too long\"}");
        }
    }
    return 0;
}
```

## src/led_control.c
```c
/*
 * Zephyr LED driver: physical pins come from each board's devicetree aliases.
 * Only led0..led3 are considered in Phase 1. A board with fewer aliases builds
 * with fewer LEDs; a board with more needs an intentional extension here.
 *
 * IMPORTANT: gpio_pin_get_dt() did not reliably reflect commanded output in
 * our initial nRF52840 experiment. LED_GET intentionally reports the LAST
 * SUCCESSFULLY COMMANDED state, not an independent electrical measurement.
 */
#include "led_control.h"

#include <errno.h>
#include <stddef.h>
#include <zephyr/devicetree.h>
#include <zephyr/drivers/gpio.h>
#include <zephyr/sys/util.h>

#define HIL_LED_AVAILABLE(n) \
    (DT_NODE_EXISTS(DT_ALIAS(led##n)) && DT_NODE_HAS_STATUS(DT_ALIAS(led##n), okay))

/* Aliases must be contiguous for 1-based indexing to be intuitive. */
#if !HIL_LED_AVAILABLE(0)
#error "No usable led0 devicetree alias; add board overlay or LED driver"
#endif

static const struct gpio_dt_spec leds[] = {
    GPIO_DT_SPEC_GET(DT_ALIAS(led0), gpios),
#if HIL_LED_AVAILABLE(1)
    GPIO_DT_SPEC_GET(DT_ALIAS(led1), gpios),
#endif
#if HIL_LED_AVAILABLE(2)
    GPIO_DT_SPEC_GET(DT_ALIAS(led2), gpios),
#endif
#if HIL_LED_AVAILABLE(3)
    GPIO_DT_SPEC_GET(DT_ALIAS(led3), gpios),
#endif
};

#define HIL_LED_COUNT ARRAY_SIZE(leds)
static bool led_states[HIL_LED_COUNT];

int led_control_init(void)
{
    for (size_t i = 0; i < HIL_LED_COUNT; ++i) {
        if (!gpio_is_ready_dt(&leds[i])) {
            return -ENODEV;
        }
        int result = gpio_pin_configure_dt(&leds[i], GPIO_OUTPUT_INACTIVE);
        if (result != 0) {
            return result;
        }
        led_states[i] = false;
    }
    return 0;
}

int led_control_count(void)
{
    return (int)HIL_LED_COUNT;
}

int led_control_set(int index, bool on)
{
    if (index < 1 || index > (int)HIL_LED_COUNT) {
        return -EINVAL;
    }
    int result = gpio_pin_set_dt(&leds[index - 1], on ? 1 : 0);
    if (result == 0) {
        led_states[index - 1] = on;
    }
    return result;
}

int led_control_get(int index, bool *on)
{
    if (index < 1 || index > (int)HIL_LED_COUNT || on == NULL) {
        return -EINVAL;
    }
    *on = led_states[index - 1];
    return 0;
}
```

## src/led_control.h
```c
#ifndef HIL_LED_CONTROL_H
#define HIL_LED_CONTROL_H

#include <stdbool.h>

/*
 * Vendor-independent logical LED interface used by the JSON command handler.
 * Indices are 1-based (LED1 = 1), matching Robot Framework keywords.
 * Return 0 on success, negative errno on failure.
 */
int led_control_init(void);
int led_control_count(void);
int led_control_set(int index, bool on);
int led_control_get(int index, bool *on);

#endif /* HIL_LED_CONTROL_H */
```
